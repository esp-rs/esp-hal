memset = 0x400004a8;
memcpy = 0x400004ac;
memmove = 0x400004b0;
memcmp = 0x400004b4;

strncmp = 0x400004c4;
strncpy = 0x400004bc;
strcpy = 0x400004b8;

abs = 0x40000578;

PROVIDE(strcat = 0x4000052c);
PROVIDE(strcmp = 0x400004c0);
PROVIDE(strchr = 0x40000534);
PROVIDE(strlcpy = 0x40000544);
PROVIDE(strstr = 0x400004cc);
PROVIDE(strcasecmp = 0x40000524);
